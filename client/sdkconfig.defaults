## client/sdkconfig.defaults
```kconfig
CONFIG_ESP_MAIN_TASK_STACK_SIZE=20000
CONFIG_ESP_SYSTEM_EVENT_TASK_STACK_SIZE=4096
# # 
# # CONFIG_ETH_RMII_CLK_INPUT is not set

# CONFIG_ETH_DMA_BUFFER_SIZE=512
# CONFIG_ETH_DMA_RX_BUFFER_NUM=10
# CONFIG_ETH_DMA_TX_BUFFER_NUM=10

# CONFIG_ETH_RMII_CLK_OUT_GPIO=17
# CONFIG_ETH_RMII_CLK_OUT_GPIO=0 //< похоже эта настройка перекрыватеся в рантайме

CONFIG_ETH_USE_ESP32_EMAC=y
CONFIG_ETH_ENABLED=y
CONFIG_ETH_PHY_INTERFACE_RMII=y
CONFIG_ETH_PHY_INTERFACE_MII=n
CONFIG_ETH_RMII_CLK_OUTPUT=y
CONFIG_WIFI_ENABLED=n
CONFIG_ETH_USE_SPI_ETHERNET=n

CONFIG_LWIP_IPV4=y
CONFIG_LWIP_IPV6=n

CONFIG_LWIP_ENABLED=y
CONFIG_LWIP_API_LIB_DEBUG=y
CONFIG_LWIP_BRIDGEIF_FDB_DEBUG=y
CONFIG_LWIP_BRIDGEIF_FW_DEBUG=y
CONFIG_LWIP_BRIDGEIF_DEBUG=y
CONFIG_LWIP_DHCP_DEBUG=y
CONFIG_LWIP_DHCP_STATE_DEBUG=y
CONFIG_LWIP_DNS_DEBUG=y
CONFIG_LWIP_ETHARP_DEBUG=y
CONFIG_LWIP_ICMP_DEBUG=y
CONFIG_LWIP_ICMP6_DEBUG=y
CONFIG_LWIP_IP_DEBUG=y
CONFIG_LWIP_IP6_DEBUG=y
CONFIG_LWIP_NAPT_DEBUG=y
CONFIG_LWIP_NETIF_DEBUG=y
CONFIG_LWIP_PBUF_DEBUG=y
CONFIG_LWIP_SNTP_DEBUG=y
CONFIG_LWIP_SOCKETS_DEBUG=y
CONFIG_LWIP_TCP_DEBUG=y
CONFIG_LWIP_UDP_DEBUG=y
CONFIG_LWIP_DEBUG_ESP_LOG=y
```
